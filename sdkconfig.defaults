## sdkconfig.defaults
```kconfig
# ============================================================
# Memoria OS —— sdkconfig.defaults
# 芯片：ESP32-S3-WROOM-2 N16R8 (16MB Flash, 8MB Octal PSRAM)
# 语言：纯 C++ (无 exceptions / RTTI)
# ============================================================

# ---- 芯片目标 ----
CONFIG_IDF_TARGET="esp32s3"

# ---- C++ 编译器 ----
CONFIG_COMPILER_CXX=y
CONFIG_COMPILER_CXX_EXCEPTIONS=n
CONFIG_COMPILER_RTTI=n
CONFIG_COMPILER_CXX_RTTI=n

# ---- Flash ----
CONFIG_ESPTOOLPY_FLASHSIZE_16MB=y
CONFIG_ESPTOOLPY_FLASHMODE_QIO=y
CONFIG_ESPTOOLPY_FLASHFREQ_80M=y

# ---- PSRAM (Octal SPI 8MB) ----
CONFIG_ESP32S3_SPIRAM_SUPPORT=y
CONFIG_SPIRAM_MODE_OCT=y
CONFIG_SPIRAM_SPEED_80M=y
CONFIG_SPIRAM_USE_MALLOC=y
CONFIG_SPIRAM_MALLOC_ALWAYSINTERNAL=16384
CONFIG_SPIRAM_MALLOC_RESERVE_INTERNAL=32768

# ---- WiFi ----
CONFIG_ESP_WIFI_ENABLED=y
CONFIG_ESP32_WIFI_ENABLED=y
CONFIG_ESP_WIFI_STATIC_RX_BUFFER_NUM=4
CONFIG_ESP_WIFI_DYNAMIC_RX_BUFFER_NUM=8
CONFIG_ESP_WIFI_DYNAMIC_TX_BUFFER_NUM=8
CONFIG_ESP32_WIFI_TX_BUFFER_TYPE=1
CONFIG_ESP_WIFI_IRAM_OPT=y
CONFIG_ESP_WIFI_RX_IRAM_OPT=y
CONFIG_ESP32_WIFI_CACHE_TX_BUFFER_NUM=16
CONFIG_ESP32_WIFI_ENABLE_WPA3_SAE=y
CONFIG_WIFI_CONSOLE_LOG_LEVEL=1
CONFIG_WIFI_SCAN_METHOD_FAST=y

# ---- BLE（仅 BLE，经典蓝牙物理不支持 S3）----
CONFIG_BT_ENABLED=y
CONFIG_BTDM_CTRL_MODE_BLE_ONLY=y
CONFIG_BT_BLUEDROID_ENABLED=n
CONFIG_BT_NIMBLE_ENABLED=y
CONFIG_BT_NIMBLE_ROLE_PERIPHERAL=y
CONFIG_BT_NIMBLE_ROLE_CENTRAL=y
CONFIG_BT_GATTS_ENABLE=y
CONFIG_BT_GATT_ENABLE=y
CONFIG_BT_SM_ENABLE=y
CONFIG_BT_GAP_ENABLE=y
CONFIG_BT_NIMBLE_MAX_CONNECTIONS=2
CONFIG_BT_NIMBLE_MAX_PERIODIC_ADV_LIST=1

# ---- JPEG 解码 ----
CONFIG_ESP_JPEG_DEC_ENABLE=y

# ---- FATFS ----
CONFIG_FATFS_MAX_LFN=255
CONFIG_FATFS_CODEPAGE=437

# ---- 分区表 ----
CONFIG_PARTITION_TABLE_CUSTOM=y
CONFIG_PARTITION_TABLE_CUSTOM_FILENAME="partitions.csv"
CONFIG_PARTITION_TABLE_FILENAME="partitions.csv"

# ---- FreeRTOS ----
CONFIG_FREERTOS_HZ=1000
CONFIG_FREERTOS_UNICORE=n
CONFIG_FREERTOS_NUM_CORES=2
CONFIG_ESP_MAIN_TASK_STACK_SIZE=8192
CONFIG_FREERTOS_DEFAULT_TASK_STACK_SIZE=2048

# ---- 调试 ----
CONFIG_LOG_DEFAULT_LEVEL=3
CONFIG_ESP_SYSTEM_PANIC_PRINT_REBOOT=y
CONFIG_LOG_COLORS=y

# ---- ADC ----
CONFIG_ADC_ONESHOT_MODE_IMPL=y

# ---- SDMMC SPI ----
CONFIG_SD_SPI_MODE=y

# ---- Heap ----
CONFIG_ESP_HEAP_POISONING_LIGHT=y

# ---- HTTP Client + HTTPS OTA ----
CONFIG_MBEDTLS_CERTIFICATE_BUNDLE=y
CONFIG_MBEDTLS_CERTIFICATE_BUNDLE_DEFAULT_FULL=y
CONFIG_ESP_HTTP_CLIENT_ENABLE_HTTPS=y
CONFIG_ESP_HTTPS_OTA_DECRYPT_CB=0

# ---- esp_http_client / esp_https_ota auto-enabled via dependencies ----

# ---- TinyUSB (如果有 USB OTG 需求；当前项目未使用) ----
CONFIG_TINYUSB_ENABLED=n
```
