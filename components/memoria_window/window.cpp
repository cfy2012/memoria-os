/**
 * @file window.cpp
 * @brief 窗口管理器实现：摇杆导航 + 状态栏 + 自制 8×12 ASCII 字体 + 光标
 */

#include "window.hpp"
#include "gb2312_font.hpp"
#include "ili9341.hpp"
#include "rtc_clock.hpp"
#include "wifi_manager.hpp"
#include "ble_manager.hpp"
#include "battery_adc.hpp"
#include "joystick.hpp"

extern "C" {
#include <esp_log.h>
#include <freertos/FreeRTOS.h>
#include <freertos/semphr.h>
}

#include <algorithm>
#include <cstring>

namespace memoria {
namespace window {

using namespace drivers;

static const char* TAG = "WINDOW";

/* ============================================================
 *  WindowManager：顶层窗口栈 + 导航事件分发
 * ============================================================ */
WindowManager* WindowManager::instance() {
    static WindowManager inst;
    return &inst;
}

esp_err_t WindowManager::init() {
    /* 创建状态栏：常驻顶层窗口栈底部 */
    auto sb = std::make_shared<StatusBar>();
    sb->set_rect({0, 0, static_cast<int16_t>(SCREEN_W), 16});
    sb->set_visible(true);
    _stack.push_back(std::move(sb));

    ESP_LOGI(TAG, "WindowManager OK. SCREEN=%dx%d", SCREEN_W, SCREEN_H);
    return ESP_OK;
}

void WindowManager::push_top(std::shared_ptr<Window> w) {
    if (!w) return;
    /* 如果栈里已经有一个顶层不是状态栏：把它 pop 出栈
     * 但不销毁（留在 children 里），保持应用内页面栈 */
    if (_stack.size() > 1) {
        _stack.pop_back();  /* 移除上次 push 的顶层窗口（但仍持有 shared_ptr） */
    }
    _stack.push_back(std::move(w));
}

void WindowManager::pop_top() {
    if (_stack.size() > 1) {
        _stack.pop_back();  /* 只 pop 应用窗口，状态栏不动 */
    }
}

Window* WindowManager::top() {
    if (_stack.empty()) return nullptr;
    /* 返回除了状态栏以外的顶层窗口 */
    if (_stack.size() > 1) return _stack.back().get();
    return nullptr;
}

void WindowManager::dispatch_nav(const NavInput& ni) {
    /* 全局钩子优先 */
    for (auto& cb : _global_navs) {
        if (cb(ni)) return;  /* 被消费 */
    }
    _dispatch_to_stack(ni);
}

void WindowManager::dispatch_sys(SysEvent se) {
    for (auto& cb : _global_sys) {
        if (cb(se)) return;
    }
    _dispatch_sys_to_stack(se);
}

bool WindowManager::_dispatch_to_stack(const NavInput& ni) {
    /* 从栈顶（最新）往底（状态栏）遍历：Z-order 自动冒泡 */
    for (auto it = _stack.rbegin(); it != _stack.rend(); ++it) {
        if (!it->get() || !(*it)->visible()) continue;
        if ((*it)->on_nav(ni)) return true;
    }
    return false;
}

bool WindowManager::_dispatch_sys_to_stack(SysEvent se) {
    for (auto it = _stack.rbegin(); it != _stack.rend(); ++it) {
        if (!it->get() || !(*it)->visible()) continue;
        if ((*it)->on_sys(se)) return true;
    }
    return false;
}

void WindowManager::render_all() {
    /* 清空 framebuffer（黑色） */
    drivers::Ili9341::instance()->fill(COLOR_BLACK);

    /* 从底到顶渲染：先画状态栏，再画应用窗口 */
    for (auto& w : _stack) {
        if (w && w->visible()) w->on_render();
    }

    /* 推屏 */
    drivers::Ili9341::instance()->flush();
}

/* ============================================================
 *  StatusBar：16px 高状态栏
 * ============================================================ */
StatusBar::StatusBar() {
    _rect = {0, 0, static_cast<int16_t>(SCREEN_W), 16};
    set_rect(_rect);
}

void StatusBar::on_render() {
    auto* ui = UIRenderer::instance();
    ui->fill_rect(_rect, COLOR_BLACK);
    ui->draw_rect(_rect, COLOR_DARK_GRAY, 1);

    /* 时间（右对齐） */
    char time_str[8];
    /* 这里简单从 RTC 直接读，不缓存 */
    auto t = drivers::RtcClock::instance()->now();
    snprintf(time_str, sizeof(time_str), "%02u:%02u", t.hour, t.minute);
    ui->draw_text(SCREEN_W - 7 * 8 - 2, 2, time_str, COLOR_LIGHT_GRAY);

    /* WiFi 图标（简化：用 ASCII 'W' 代替真正的图标，后续可换自定义 bitmaps） */
    if (drivers::WifiManager::instance()->connected()) {
        ui->draw_text(2, 2, "[W]", COLOR_GREEN);
    } else {
        ui->draw_text(2, 2, "[w]", COLOR_DARK_GRAY);
    }

    /* BLE 图标 */
    if (drivers::BleManager::instance()->connected()) {
        ui->draw_text(26, 2, "[B]", COLOR_GREEN);
    } else {
        ui->draw_text(26, 2, "[b]", COLOR_DARK_GRAY);
    }

    /* 电量（简易：百分比数字） */
    uint8_t pct = drivers::BatteryAdc::instance()->percent();
    bool low = drivers::BatteryAdc::instance()->is_crit();
    char bat[8]; snprintf(bat, sizeof(bat), "%u%%", pct);
    ui->draw_text(50, 2, bat, low ? COLOR_RED : COLOR_LIGHT_GRAY);
}

/* ============================================================
 *  UIRenderer：图元封装 + 自制 8×12 ASCII 字体
 * ============================================================ */

/* ---------- 自制 8×12 ASCII 字体 ---------- */
/* 每个 glyph = 12 字节，每行 8 bit 左对齐 = 1 字节 */
static const uint8_t FONT_8x12[][12] = {
    /* 0x20 ' ' */ {0x00,0x00,0x00,0x00,0x00,0x00,0x00,0x00,0x00,0x00,0x00,0x00},
    /* 0x21 '!' */ {0x00,0x00,0x18,0x18,0x18,0x18,0x18,0x18,0x00,0x00,0x18,0x18},
    /* 0x22 '"' */ {0x00,0x00,0x36,0x36,0x36,0x36,0x00,0x00,0x00,0x00,0x00,0x00},
    /* 0x23 '#' */ {0x00,0x84,0x84,0xFE,0x84,0x84,0xFE,0x84,0x84,0x00,0x00,0x00},
    /* 0x24 '$' */ {0x00,0x10,0x7C,0x90,0x90,0x7C,0x14,0x12,0x7C,0x10,0x00,0x00},
    /* 0x25 '%' */ {0x00,0x62,0x64,0x08,0x10,0x20,0x4C,0x92,0x04,0x00,0x00,0x00},
    /* 0x26 '&' */ {0x00,0x30,0x48,0x48,0x30,0x76,0x18,0x18,0x00,0x00,0x00,0x00},
    /* 0x27 ''' */ {0x00,0x00,0x00,0x00,0x36,0x36,0x36,0x00,0x00,0x00,0x00,0x00},
    /* 0x28 '(' */ {0x00,0x00,0x00,0xFE,0x03,0x01,0x01,0x00,0x00,0x00,0x00,0x00},
    /* 0x29 ')' */ {0x00,0x00,0x00,0x01,0x01,0x03,0xFE,0x00,0x00,0x00,0x00,0x00},
    /* 0x2A '*' */ {0x00,0x00,0x00,0x00,0x44,0x28,0xFE,0x28,0x44,0x00,0x00,0x00},
    /* 0x2B '+' */ {0x00,0x00,0x00,0x00,0x10,0x10,0x7C,0x10,0x10,0x00,0x00,0x00},
    /* 0x2C ',' */ {0x00,0x00,0x00,0x00,0x00,0x00,0x00,0x00,0x00,0x18,0x18,0x30},
    /* 0x2D '-' */ {0x00,0x00,0x00,0x00,0x00,0x00,0xFE,0x00,0x00,0x00,0x00,0x00},
    /* 0x2E '.' */ {0x00,0x00,0x00,0x00,0x00,0x00,0x00,0x00,0x00,0x18,0x18,0x18},
    /* 0x2F '/' */ {0x00,0x00,0x00,0x00,0x02,0x04,0x08,0x10,0x20,0x40,0x80,0x00},

    /* 0-9 */
    {0x00,0x00,0x7C,0x82,0x86,0x8A,0x92,0xA2,0x7C,0x00,0x00,0x00},
    {0x00,0x00,0x10,0x30,0x10,0x10,0x10,0x10,0x7C,0x00,0x00,0x00},
    {0x00,0x00,0x7C,0x82,0x02,0x04,0x18,0x20,0xFE,0x00,0x00,0x00},
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    {0x00,0x00,0x7C,0x82,0x82,0x7E,0x02,0x04,0x78,0x00,0x00,0x00},

    /* 0x3A ':' */ {0x00,0x00,0x00,0x18,0x18,0x00,0x00,0x18,0x18,0x00,0x00,0x00},
    /* 0x3B ';' */ {0x00,0x00,0x00,0x18,0x18,0x00,0x00,0x18,0x18,0x30,0x18,0x00},
    /* 0x3C '<' */ {0x00,0x00,0x00,0x00,0x02,0x04,0x08,0x10,0x20,0x40,0x80,0x00},
    /* 0x3D '=' */ {0x00,0x00,0x00,0x00,0x00,0x7C,0x00,0x00,0x7C,0x00,0x00,0x00},
    /* 0x3E '>' */ {0x00,0x00,0x00,0x00,0x80,0x40,0x20,0x10,0x08,0x04,0x02,0x00},
    /* 0x3F '?' */ {0x00,0x00,0x3C,0x42,0x42,0x04,0x08,0x10,0x00,0x10,0x00,0x00},
    /* 0x40 '@' */ {0x00,0x00,0x7C,0x82,0xBA,0xAA,0xBA,0x82,0x7C,0x00,0x00,0x00},

    /* A-Z */
    {0x00,0x00,0x00,0x7C,0x82,0x82,0xFE,0x82,0x82,0x00,0x00,0x00},
    {0x00,0x00,0xFE,0x82,0x82,0x7C,0x82,0x82,0xFE,0x00,0x00,0x00},
    {0x00,0x00,0x7C,0x82,0x80,0x80,0x80,0x82,0x7C,0x00,0x00,0x00},
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    {0x00,0x00,0xFE,0x02,0x04,0x08,0x10,0x20,0xFE,0x00,0x00,0x00},

    /* 0x5B '[' */ {0x00,0x00,0x00,0xFE,0x80,0x80,0x80,0x00,0x00,0x00,0x00,0x00},
    /* 0x5C '\' */ {0x00,0x00,0x00,0x02,0x04,0x08,0x10,0x20,0x40,0x80,0x00,0x00},
    /* 0x5D ']' */ {0x00,0x00,0x00,0x80,0x80,0x80,0xFE,0x00,0x00,0x00,0x00,0x00},
    /* 0x5E '^' */ {0x00,0x00,0x10,0x28,0x44,0x00,0x00,0x00,0x00,0x00,0x00,0x00},
    /* 0x5F '_' */ {0x00,0x00,0x00,0x00,0x00,0x00,0x00,0x00,0xFE,0x00,0x00,0x00},
    /* 0x60 '`' */ {0x00,0x00,0x20,0x10,0x08,0x00,0x00,0x00,0x00,0x00,0x00,0x00},

    /* a-z */
    {0x00,0x00,0x00,0x00,0x00,0x78,0x14,0x7C,0x88,0x7C,0x00,0x00},
    {0x00,0x00,0x80,0x80,0x7C,0x88,0x82,0x82,0x7C,0x00,0x00,0x00},
    {0x00,0x00,0x00,0x00,0x00,0x7C,0x82,0x80,0x82,0x7C,0x00,0x00},
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    {0x00,0x00,0x00,0x00,0x00,0xFE,0x04,0x18,0x60,0x80,0xFE,0x00},

    /* 0x7B '{' */ {0x00,0x00,0x1C,0x22,0x22,0x80,0x80,0x22,0x22,0x1C,0x00,0x00},
    /* 0x7C '|' */ {0x00,0x00,0x10,0x10,0x10,0x10,0x10,0x10,0x10,0x10,0x10,0x10},
    /* 0x7D '}' */ {0x00,0x00,0xE0,0x22,0x22,0x02,0x02,0x22,0x22,0xE0,0x00,0x00},
    /* 0x7E '~' */ {0x00,0x00,0x00,0x00,0x10,0x28,0x00,0x00,0x00,0x00,0x00,0x00},
};

UIRenderer* UIRenderer::instance() {
    static UIRenderer inst;
    return &inst;
}

void UIRenderer::clear(Color c) {
    drivers::Ili9341::instance()->fill(c);
}

void UIRenderer::flush() {
    drivers::Ili9341::instance()->flush();
}

void UIRenderer::fill_rect(const Rect& r, Color c) {
    drivers::Ili9341::instance()->fill_rect(r.x, r.y, r.w, r.h, c);
}

void UIRenderer::draw_rect(const Rect& r, Color c, uint16_t thickness) {
    if (thickness == 0) thickness = 1;
    if (thickness >= r.w || thickness >= r.h) { fill_rect(r, c); return; }
    const int16_t t = static_cast<int16_t>(thickness);
    const int16_t h2 = static_cast<int16_t>(r.h - 2 * t);
    /* 四条粗边：上下横带 + 左右竖带（t=1 时与逐线绘制等价） */
    fill_rect({r.x, r.y, r.w, t}, c);
    fill_rect({r.x, static_cast<int16_t>(r.y + r.h - t), r.w, t}, c);
    fill_rect({r.x, static_cast<int16_t>(r.y + t), t, h2}, c);
    fill_rect({static_cast<int16_t>(r.x + r.w - t), static_cast<int16_t>(r.y + t), t, h2}, c);
}

void UIRenderer::draw_cursor(const Rect& r, Color c, uint16_t thickness) {
    draw_rect(r, c, thickness);
    /* 闪烁效果由窗口应用层控制重绘频率 */
}

void UIRenderer::draw_image(const Rect& r, const uint16_t* rgb565_buf,
                              uint16_t img_w, uint16_t img_h) {
    if (!rgb565_buf) return;
    /* 简化：只画左上部分的一部分（缩放由 JPEG 解码时已完成） */
    (void)img_w; (void)img_h;
    auto* fb = drivers::Ili9341::instance()->framebuffer();
    /* 把 buf 直接拷到 framebuffer 对应位置 */
    /* 注意：这里不做缩放，假定调用者已准备好目标尺寸 buffer */
    uint16_t copy_w = std::min<uint16_t>(r.w, img_w);
    uint16_t copy_h = std::min<uint16_t>(r.h, img_h);
    for (uint16_t y = 0; y < copy_h; y++) {
        for (uint16_t x = 0; x < copy_w; x++) {
            uint16_t screen_x = r.x + x;
            uint16_t screen_y = r.y + y;
            if (screen_x < SCREEN_W && screen_y < SCREEN_H) {
                fb[screen_y * SCREEN_W + screen_x] = rgb565_buf[y * img_w + x];
            }
        }
    }
}

int UIRenderer::text_width_utf8(const std::string& text) {
    /* UTF-8 混排像素宽度：ASCII 8px（FONT_W），多字节序列（中文 GB2312 字库）16px。
     * 用于绘制前居中/裁剪判定——禁止用字节数估算（UTF-8 中文 3 字节/字） */
    int w = 0;
    size_t i = 0;
    while (i < text.size()) {
        const uint8_t b0 = static_cast<uint8_t>(text[i]);
        if (b0 < 0x80) {
            w += FONT_W;
            i += 1;
        } else if ((b0 & 0xE0) == 0xC0) {
            w += 2 * FONT_W; i += 2;
        } else if ((b0 & 0xF0) == 0xE0) {
            w += 2 * FONT_W; i += 3;
        } else if ((b0 & 0xF8) == 0xF0) {
            w += 2 * FONT_W; i += 4;
        } else {                        /* 非法字节：按全宽回退处理，前进 1 字节防死循环 */
            w += 2 * FONT_W;
            i += 1;
        }
    }
    return w;
}

void UIRenderer::draw_text(int16_t x, int16_t y, const std::string& text, Color c) {
    /* 统一走 UTF-8 混合渲染：ASCII 8×12 字模 + 中文 GB2312 字库（TF 卡）
     * 原实现跳过所有非 ASCII 字符——中文一律显示为空白 */
    draw_text_utf8(x, y, text, c);
}

void UIRenderer::draw_text_utf8(int16_t x, int16_t y, const std::string& text, Color c) {
    auto* fb = drivers::Ili9341::instance()->framebuffer();
    if (!fb) return;
    auto* lcd = drivers::Ili9341::instance();

    int16_t cx = x;
    size_t i = 0;
    while (i < text.size()) {
        const uint8_t b0 = static_cast<uint8_t>(text[i]);
        if (b0 < 0x80) {
            /* ASCII：直接复用 8×12 */
            if (b0 >= 0x20 && b0 <= 0x7E) {
                const uint8_t* glyph = FONT_8x12[b0 - 0x20];
                for (int row = 0; row < FONT_H; row++) {
                    uint8_t line = glyph[row];
                    for (int col = 0; col < 8; col++) {
                        if (line & (0x80 >> col)) {
                            int16_t sx = cx + col, sy = y + row;
                            if (sx >= 0 && sx < SCREEN_W && sy >= 0 && sy < SCREEN_H)
                                fb[sy * SCREEN_W + sx] = c;
                        }
                    }
                }
            }
            cx += FONT_W;
            i++;
            continue;
        }

        /* UTF-8 多字节 → Unicode */
        uint32_t cp = 0;
        size_t len = 0;
        if ((b0 & 0xE0) == 0xC0)      { cp = b0 & 0x1F; len = 2; }
        else if ((b0 & 0xF0) == 0xE0) { cp = b0 & 0x0F; len = 3; }
        else if ((b0 & 0xF8) == 0xF0) { cp = b0 & 0x07; len = 4; }
        else { cx += FONT_W; i++; continue; }
        if (i + len > text.size()) break;
        for (size_t k = 1; k < len; k++)
            cp = (cp << 6) | (static_cast<uint8_t>(text[i + k]) & 0x3F);

        int idx = gb2312_index(cp);
        if (idx < 0) {
            /* 缺字：画一个空心方框占位 */
            lcd->draw_rect(cx, y, CJK_W, CJK_H, c);
            cx += CJK_W;
            i += len;
            continue;
        }
        const uint8_t* glyph = gb2312_glyph(idx);
        if (!glyph) {
            /* 字库未加载（缺 TF 卡）或索引越界：与缺字一致画空心方框 */
            lcd->draw_rect(cx, y, CJK_W, CJK_H, c);
            cx += CJK_W;
            i += len;
            continue;
        }
        for (int row = 0; row < CJK_H; row++) {
            uint8_t hi = glyph[row * 2];
            uint8_t lo = glyph[row * 2 + 1];
            for (int col = 0; col < 16; col++) {
                uint8_t bit = (col < 8) ? (hi & (0x80 >> col)) : (lo & (0x80 >> (col - 8)));
                if (bit) {
                    int16_t sx = cx + col, sy = y + row;
                    if (sx >= 0 && sx < SCREEN_W && sy >= 0 && sy < SCREEN_H)
                        fb[sy * SCREEN_W + sx] = c;
                }
            }
        }
        cx += CJK_W;
        i += len;
    }
}

} // namespace window
} // namespace memoria